/*
 * Copyright 2023 NXP
 *
 * SPDX-License-Identifier: Apache-2.0
 */

/dts-v1/;

#include <nxp/nxp_rw6xx_ns.dtsi>
#include "rd_rw612_bga.dtsi"

/ {
	model = "NXP RD_RW612_BGA board NS";
	compatible = "nxp,rw612";
};
