/*
 * Copyright 2023 NXP
 *
 * SPDX-License-Identifier: Apache-2.0
 */

#include "rd_rw612_bga.dts"

/*
 * To use ethernet on RD_RW612_BGA board:
 *
 * Load R485, R486, R487, R488, R489, R491, R490,
 * 	R522, R521, R520, R524, R523, R508, R505
 * Remove R518, R507, R506
 */
&enet {
	status = "okay";
	pinctrl-0 = <&pinmux_enet>;
	pinctrl-names = "default";
	int-gpios = <&hsgpio1 23 GPIO_ACTIVE_HIGH>;
	reset-gpios = <&hsgpio0 21 GPIO_ACTIVE_HIGH>;
	phy-addr = <2>;
};

/* XTAL is disconnected */
&rtc {
	status = "disabled";
};
