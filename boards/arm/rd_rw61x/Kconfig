## boards/arm/rd_rw61x/Kconfig
```kconfig
# Copyright (c) 2022 Nordic Semiconductor ASA
# Copyright 2023 NXP
# SPDX-License-Identifier: Apache-2.0

config BOARD_INIT_PRIORITY
	int "Board initialization priority"
	default 45
	help
	  Board initialization priority.

config USE_ELS_PKC_HUK
	bool "For TF-M, use a die internal HUK"
	depends on BUILD_WITH_TFM && MCUX_PSA_CRYPTO_DRIVER_ELS_PKC
	default y
	help
	  For TF-M, use a HUK that is derived from the die internal master key of the ELS.

config USE_ELS_PKC_IAK
	bool "For TF-M, use ELS-backed key for initial attestation"
	depends on BUILD_WITH_TFM && MCUX_PSA_CRYPTO_DRIVER_ELS_PKC
	default y
	help
	  For TF-M, use a IAK that is an ELS internal key derived from the NXP root of trust.

config USE_HARDENED_PLATFORM_INIT
	bool "For TF-M, use hardened platform initialization code"
	depends on BUILD_WITH_TFM
	default y
	help
	  For TF-M, use platform initialization code that is hardened against fault injections.
	  For critical registers, the written value is read back and compared against the wanted
	  value to ensure correctness.

config TFM_PARTITION_LOADER_SERVICE
	bool "Loader service Partition"
	depends on BUILD_WITH_TFM && MCUX_PSA_CRYPTO_DRIVER_ELS_PKC && NXP_FW_LOADER
	default y
	help
	  Setting this option will cause '-DTFM_PARTITION_LOADER_SERVICE'
	  to be passed to the TF-M build system. Look at 'config_default.cmake'
	  in the trusted-firmware-m repository for details regarding this
	  parameter. Any dependencies between the various TFM_PARTITION_*
	  options are handled by the build system in the trusted-firmware-m
	  repository.
```

## boards/arm/rd_rw61x/Kconfig.board
```kconfig
# Copyright 2023 NXP
# SPDX-License-Identifier: Apache-2.0

config BOARD_RD_RW612_BGA
	bool "NXP RD_RW612_BGA"
	depends on SOC_SERIES_RW6XX
	select SOC_PART_NUMBER_RW612ETA1I
	select NXP_RW6XX_BOOT_HEADER if !BOOTLOADER_MCUBOOT && !TRUSTED_EXECUTION_NONSECURE
```

## boards/arm/rd_rw61x/Kconfig.defconfig
```kconfig
# RD_RW612_BGA board

# Copyright 2022 NXP
# SPDX-License-Identifier: Apache-2.0

if BOARD_RD_RW612_BGA

config BOARD
	default "rd_rw612_bga"

choice FLASH_MCUX_FLEXSPI_XIP_MEM_TARGET
	default FLASH_MCUX_FLEXSPI_XIP_MEM_SRAM
endchoice

if LVGL

SWAP_BYTES := nxp,swap-bytes

# Swap color order for the default display panel
config LV_COLOR_16_SWAP
	default y if SPI
	# This will enable color swapping if the LCDIC does not have
	# the nxp,swap-bytes property set.
	default y if !$(dt_nodelabel_bool_prop,lcdic,$(SWAP_BYTES))

# Enable DMA mode if using SPI
config SPI_MCUX_FLEXCOMM_DMA
	default y if SPI

# Enable DMA for LCDIC as well
config MIPI_DBI_NXP_LCDIC_DMA
	default y if MIPI_DBI

# Increase descriptor count. LVGL will allocate a 30KB buffer,
# and the SPI driver sets up RX and TX side. Since LPC DMA has
# 1KB limit per descriptor, we need 60
config DMA_MCUX_LPC_NUMBER_OF_DESCRIPTORS
	default 60

# Allocate buffer that is 10% of screen size
config LV_Z_VDB_SIZE
	default 10

# Enable double buffering and offloaded render thread to improve performance
config LV_Z_DOUBLE_VDB
	default y

config LV_Z_FLUSH_THREAD
	default y

# Enable input subsystem for FT5336 driver
config INPUT
	default y

# KSCAN subsystem must be enabled for KSCAN input shim driver
config KSCAN
	default y

# Configure LVGL to use touchscreen with KSCAN API
config LV_Z_POINTER_KSCAN
	default y

# Swap X/Y coordinates, and invert Y to match screen layout
config LV_Z_POINTER_KSCAN_SWAP_XY
	default y

config LV_Z_POINTER_KSCAN_INVERT_Y
	default y


endif # LVGL

# Limit flash load size to avoid overwriting fw storage partition
# Flash load size must be given in hex, as a number of bytes
config FLASH_LOAD_SIZE
	default 0x400000 if !BOOTLOADER_MCUBOOT

# This is a workaround for not being able to define the BOOT_MAX_IMG_SECTORS
# within the MCUBoot board .conf file, since no fork of MCUBoot is maintained
# for the RW. We must define the BOOT_MAX_IMG_SECTORS Kconfig here to
# prevent undefined KConfig warnings when not building MCUBoot
config BOOT_MAX_IMG_SECTORS
	int "Max image sectors (MCUBoot)"
	help
	  Max sectors for bootable image. Used by MCUBoot to determine
	  the max slot size of an image.

if DT_HAS_NXP_KINETIS_ETHERNET_ENABLED && NETWORKING

config NET_L2_ETHERNET
	default y

endif # DT_HAS_NXP_KINETIS_ETHERNET_ENABLED && NETWORKING

endif # BOARD_RD_RW612_BGA
```

## boards/arm/rd_rw61x/rd_rw612_bga_defconfig
```kconfig
#
# Copyright 2022 NXP
#
# SPDX-License-Identifier: Apache-2.0
#

CONFIG_SOC_RW612=y
CONFIG_SOC_SERIES_RW6XX=y
CONFIG_BOARD_RD_RW612_BGA=y
CONFIG_CONSOLE=y
CONFIG_UART_CONSOLE=y
CONFIG_SERIAL=y
CONFIG_PINCTRL=y
CONFIG_UART_INTERRUPT_DRIVEN=y
CONFIG_GPIO=y
# Enable TrustZone-M
CONFIG_TRUSTED_EXECUTION_SECURE=y
CONFIG_ARM_MPU=y
CONFIG_HW_STACK_PROTECTION=y
```

## boards/arm/rd_rw61x/rd_rw612_bga_ns_defconfig
```kconfig
#
# Copyright 2023 NXP
#
# SPDX-License-Identifier: Apache-2.0
#

CONFIG_SOC_RW612=y
CONFIG_SOC_SERIES_RW6XX=y
CONFIG_BOARD_RD_RW612_BGA=y

CONFIG_CONSOLE=y
CONFIG_UART_CONSOLE=y
CONFIG_SERIAL=y
CONFIG_PINCTRL=y
CONFIG_UART_INTERRUPT_DRIVEN=y
CONFIG_GPIO=y
# Enable TrustZone-M
CONFIG_TRUSTED_EXECUTION_NONSECURE=y
CONFIG_ARM_MPU=y
CONFIG_HW_STACK_PROTECTION=y

# Set max boot sector count for MCUBoot
CONFIG_BOOT_MAX_IMG_SECTORS=1024

CONFIG_TFM_BL2=n
CONFIG_BUILD_WITH_TFM=y

# FW loader
CONFIG_NXP_FW_LOADER=y
```

## boards/arm/rdrw610_evk/Kconfig.board
```kconfig
# Copyright (c) 2022, NXP
# SPDX-License-Identifier: Apache-2.0

config BOARD_RDRW610_EVK
	bool "NXP RW610-EVK"
	depends on SOC_SERIES_RW6XX
	select SOC_PART_NUMBER_RW610EVA0IK
	select NXP_RW6XX_BOOT_HEADER if !BOOTLOADER_MCUBOOT
```

## boards/arm/rdrw610_evk/Kconfig.defconfig
```kconfig
# RDRW610-EVK board

# Copyright 2022 NXP
# SPDX-License-Identifier: Apache-2.0

if BOARD_RDRW610_EVK

config BOARD
	default "rdrw610_evk"

if LVGL

# Swap color order for the default display panel
config LV_COLOR_16_SWAP
	default y

# Enable DMA mode if using SPI
config SPI_MCUX_FLEXCOMM_DMA
	default y if SPI

# Increase descriptor count. LVGL will allocate a 30KB buffer,
# and the SPI driver sets up RX and TX side. Since LPC DMA has
# 1KB limit per descriptor, we need 60
config DMA_MCUX_LPC_NUMBER_OF_DESCRIPTORS
	default 60

# Allocate buffer that is 10% of screen size
config LV_Z_VDB_SIZE
	default 10

endif # LVGL

endif # BOARD_RDRW610_EVK
```

## boards/arm/rdrw610_evk/rdrw610_evk_defconfig
```kconfig
#
# Copyright 2022 NXP
#
# SPDX-License-Identifier: Apache-2.0
#

CONFIG_SOC_RW610=y
CONFIG_SOC_SERIES_RW6XX=y
CONFIG_BOARD_RDRW610_EVK=y
CONFIG_CONSOLE=y
CONFIG_UART_CONSOLE=y
CONFIG_SERIAL=y
CONFIG_PINCTRL=y
#CONFIG_UART_INTERRUPT_DRIVEN=y
CONFIG_GPIO=y
# Enable TrustZone-M
CONFIG_TRUSTED_EXECUTION_SECURE=y
CONFIG_CORTEX_M_SYSTICK=y
CONFIG_SYS_CLOCK_HW_CYCLES_PER_SEC=250000000
CONFIG_ARM_MPU=y
CONFIG_HW_STACK_PROTECTION=y
```

## drivers/bluetooth/hci/Kconfig.nxp
```kconfig
#
# Copyright 2023 NXP
#
# SPDX-License-Identifier: Apache-2.0
#

config HCI_NXP_SET_BDADDR
	bool "HCI Set BT Address"
	default n
	help
	  If enabled, the BD_ADDR will be set by the host at HCI init, using a HCI vendor command.
```

## drivers/sensor/nxp_gau_acomp/Kconfig
```kconfig
# NXP GAU ACOMP Kconfig options

config NXP_GAU_ACOMP
	bool "NXP General Analog Unit Comparator (ACOMP)"
	default y
	depends on DT_HAS_NXP_GAU_ACOMP_SENSOR_ENABLED
	help
	  Enable driver for the NXP GAU ACOMP.
```

## dts/bindings/adc/nxp,gau-adc.yaml
```yaml
# Copyright 2022 NXP
# SPDX-License-Identifier: Apache-2.0

description: |
  NXP GAU GPADC.

compatible: "nxp,gau-adc"

include:
  - name: base.yaml
  - name: adc-controller.yaml

properties:
  reg:
    required: true

  interrupts:
    required: true

  resolution:
    type: int
    required: true
    description: |
      Resolution of ADC in bits, this is global to every channel.
      Note that the Zephyr API will allow changing resolution
      at channel_setup call, but this ADC cannot have different
      resolutions for each channel.
    enum:
      - 11
      - 13
      - 15

  oversampling:
    type: int
    required: false
    description: |
      Number of raw samples to average for result sample.
      Note that the Zephyr API will allow changing oversample amount
      at channel_setup call, but this ADC cannot have different
      averaging configurations for each channel.
      The default is no oversampling, which is the reset value.
    enum:
      - 0
      - 2
      - 4
      - 8
      - 16
    default: 0

  clock-divider:
    type: int
    required: false
    description: Clock divider from 1 to 32.
    default: 1

  power-mode:
    type: string
    required: false
    description: Current bias. Full bias is the default reset value.
    enum:
      - "full-bias"
      - "half-bias"
    default: "full-bias"

  warmup-time:
    type: int
    required: false
    description: |
      Warm up time in microseconds (1 to 32 us). The default 33 is a value
      that would disable warmup time if not otherwise set.
    default: 33

  trigger-source:
    type: string
    required: false
    description: Conversion trigger source
    enum:
      - "gpt"
      - "acomp"
      - "gpio40"
      - "gpio41"
      - "software"
    default: "software"

  result-width:
    type: int
    required: false
    description: Result width in bits for each channel sample.
    enum:
      - 16
      - 32
    default: 16

  fifo-threshold:
    type: int
    required: false
    description: FIFO threshold
    enum:
      - 1
      - 4
      - 8
      - 16
    default: 1

  enable-dma:
    type: boolean
    required: false
    description: DMA enable

  input-buffer:
    type: boolean
    required: false
    description: Enable use of the input buffer

  ext-cal-volt:
    type: boolean
    required: false
    description: |
      Use external calibration voltage.
      By default, ADC uses an internal calibration voltage.

  "#io-channel-cells":
    const: 1

io-channel-cells:
  - input
```

## dts/bindings/arm/nxp,hci-ble.yaml
```yaml
# Copyright 2023 NXP
# SPDX-License-Identifier: Apache-2.0

description: HCI interrupt info

compatible: "nxp,hci-ble"

include: base.yaml

properties:
  interrupts:
    required: true
```

## dts/bindings/mipi-dbi/mipi-dbi-host.yaml
```yaml
# Copyright 2023 NXP
# SPDX-License-Identifier: Apache-2.0

description: |
  Properties common to all MIPI DBI hosts, regardless of mode used.

properties:
  cd-invert:
    type: boolean
    description: |
      Inverts polarity of command/data signal. If using 4 wire SPI mode, this
      will cause the C/D signal to be high for commands, low for data. If using
      3 wire SPI mode, the 9th command/data bit will be set to 1 for commands,
      0 for data.

  rst-invert:
    type: boolean
    description: |
      Inverts polarity of reset signal. Signal is usually active low, this
      property will configure it as active high
```

## dts/bindings/mipi-dbi/zephyr,mipi-dbi-spi.yaml
```yaml
# Copyright 2023 NXP
# SPDX-License-Identifier: Apache-2.0

description: |
  MIPI-DBI Mode C compatible SPI controller. This driver emulates MIPI DBI
  mode C using a SPI controller and GPIO pins
compatible: "zephyr,mipi-dbi-spi"

include: ["mipi-dbi-host.yaml", "spi-controller.yaml", "pinctrl-device.yaml"]

properties:
  spi-dev:
    type: phandle
    required: true
    description: |
      SPI device to use for data transfers with MIPI DBI commands. This SPI
      device should be connected to the MIPI DBI display.

  cd-gpios:
    type: phandle-array
    description: |
      Command/data gpio pin. Required when using 4 wire SPI mode (Mode C1).
      Active low, unless "cd-invert" is set.

  reset-gpios:
    type: phandle-array
    description: |
      Reset GPIO pin. Used to reset the display during initialization.
      Active low pin.
```

## dts/bindings/sensor/nxp,gau-acomp-sensor.yaml
```yaml
# Copyright 2023 NXP
# SPDX-License-Identifier: Apache-2.0

description: |
  NXP General Analog Unit Analog Comparator Sensor.
  Child of parent nxp,gau-acomp node.

compatible: "nxp,gau-acomp-sensor"

include: [sensor-device.yaml]

# NOTE: Enum indices correspond to register values. Be careful editing.

properties:
  reg:
    required: true

  nxp,warmtime:
    type: int
    enum:
      - 1
      - 2
      - 4
      - 8
    default: 1
    description: Warm-up time in microseconds. Default is reset value.

  nxp,bias-prog:
    type: string
    enum:
      - "slow"
      - "medium"
      - "fast"
    default: "slow"
    description: Bias current control or response time control. Default is reset value.

  nxp,inactive-output:
    type: boolean
    description: |
      If set, ACOMP will output 1 / high when inactive. Otherwise, it will
      output 0 / low when inactive.

  nxp,edge-pulses:
    type: string
    enum:
      - "none"
      - "rising"
      - "falling"
      - "both"
    default: "none"
    description: Edge triggered edge pulse enable/disable. Default is reset value.

  nxp,vio-scaling-factor:
    type: int
    enum:
      - 1
      - 2
      - 3
      - 4
    default: 1
    description: |
      VIO reference will be scaled by X/4. For example, if this property is 3,
      then the VIO reference will be scaled by 3/4. Default is reset value.

  nxp,invert-output:
    type: boolean
    description: Enable ACOMP output inversion to GPIO.

  nxp,pos-input:
    type: string
    required: true
    enum:
      - "CH0"
      - "CH1"
      - "CH2"
      - "CH3"
      - "CH4"
      - "CH5"
      - "CH6"
      - "CH7"
      - "DACA"
      - "DACB"
    description: Which input source to use as positive input to ACOMP.

  nxp,neg-input:
    type: string
    required: true
    enum:
      - "CH0"
      - "CH1"
      - "CH2"
      - "CH3"
      - "CH4"
      - "CH5"
      - "CH6"
      - "CH7"
      - "DACA"
      - "DACB"
      - "VREF_1P25"
      - "VSSA"
      - "VIO"
    description: Which input source to use as negative input to ACOMP.

  nxp,pos-hysteresis:
    type: int
    enum:
      - 0
      - 10
      - 20
      - 30
      - 40
      - 50
      - 60
      - 70
    default: 0
    description: Positive hysteresis in millivolts. Default is reset value.

  nxp,neg-hysteresis:
    type: int
    enum:
      - 0
      - 10
      - 20
      - 30
      - 40
      - 50
      - 60
      - 70
    default: 0
    description: Negative hysteresis in millivolts. Default is reset value.
```

## dts/bindings/sensor/nxp,gau-acomp.yaml
```yaml
# Copyright 2023 NXP
# SPDX-License-Identifier: Apache-2.0

description: |
  NXP General Analog Unit Analog Comparator Module
  Has child nxp,gau-acomp-sensor nodes.

compatible: "nxp,gau-acomp"

include: base.yaml

properties:
  reg:
    required: true

  interrupts:
    required: true
```

## modules/trusted-firmware-m/Kconfig.tfm.misc
```kconfig
#-------------------------------------------------------------------------------
# Copyright 2023 NXP
# SPDX-License-Identifier: Apache-2.0
#
#-------------------------------------------------------------------------------

################################# Mbedcrypto ###################################

menu "Mbedcrypto profile"

config TFM_MBEDCRYPTO_CONFIG_PATH
    string "Mbedtls config path"
    default "${ZEPHYR_TRUSTED_FIRMWARE_M_MODULE_DIR}/lib/ext/mbedcrypto/mbedcrypto_config/tfm_mbedcrypto_config_default.h"
    help
      Mbedcrypto configuration file. See also Kconfig.misc in TF-M repository.

config TFM_MBEDCRYPTO_PSA_CRYPTO_CONFIG_PATH
    string "Mbedtls psa crypto config path"
    default "${ZEPHYR_TRUSTED_FIRMWARE_M_MODULE_DIR}/lib/ext/mbedcrypto/mbedcrypto_config/crypto_config_default.h"
    help
      Psa crypto configuration file. See also Kconfig.misc in TF-M repository.

config TFM_MBEDCRYPTO_PLATFORM_EXTRA_CONFIG_PATH
    string "Mbedtls platform crypto config path"
    default ""
    help
      Extra options for mbedcrypto configuration. See also Kconfig.misc in TF-M repository.

endmenu
```
