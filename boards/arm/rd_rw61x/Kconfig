## modules/trusted-firmware-m/Kconfig.tfm.platform
```kconfig
#-------------------------------------------------------------------------------
# Copyright 2023 NXP
# SPDX-License-Identifier: Apache-2.0
#
#-------------------------------------------------------------------------------

menu "Platform options"

config PLATFORM_DEFAULT_BL1
    bool
    default y

config PLATFORM_DEFAULT_ATTEST_HAL
    bool
    default y

config PLATFORM_DEFAULT_NV_COUNTERS
    bool
    default y
    depends on PLATFORM_DEFAULT_OTP_WRITEABLE

config PLATFORM_DEFAULT_CRYPTO_KEYS
    bool
    default y

config PLATFORM_DEFAULT_ROTPK
    bool
    default y

config PLATFORM_DEFAULT_IAK
    bool
    default y

config PLATFORM_DEFAULT_UART_STDOUT
    bool
    default y

config PLATFORM_DEFAULT_NV_SEED
    bool
    default y

config PLATFORM_DEFAULT_OTP
    bool
    default y

config PLATFORM_DEFAULT_OTP_WRITEABLE
    bool
    default y

config PLATFORM_DEFAULT_PROVISIONING
    bool
    default y

config PLATFORM_DEFAULT_SYSTEM_RESET_HALT
    bool
    default y

config PLATFORM_HAS_FIRMWARE_UPDATE_SUPPORT
    bool
    default n
endmenu
```

## samples/bluetooth/central_hr/sample.yaml
```yaml
sample:
  name: Bluetooth Central HR
tests:
  sample.bluetooth.central_hr:
    platform_allow:
      - qemu_x86
      - rd_rw612_bga
    harness: bluetooth
    tags: bluetooth
```

## samples/bluetooth/central_ht/sample.yaml
```yaml
sample:
  name: Bluetooth Central HT
tests:
  sample.bluetooth.central_ht_coex:
    harness: bluetooth
    platform_allow:
      - rd_rw612_bga
    extra_args: CONF_FILE="prj.conf;overlay-wifi-nxp.conf"
    tags: bluetooth
    integration_platforms:
      - rd_rw612_bga
  sample.bluetooth.central_ht:
    harness: bluetooth
    platform_allow:
      - qemu_cortex_m3
      - qemu_x86
      - nrf51dk_nrf51422
      - nrf52dk_nrf52832
      - rd_rw612_bga
    tags: bluetooth
    integration_platforms:
      - qemu_cortex_m3
```

## samples/bluetooth/central_multilink/sample.yaml
```yaml
sample:
  name: Bluetooth Central Multilink
tests:
  sample.bluetooth.central.multilink:
    harness: bluetooth
    platform_allow:
      - qemu_cortex_m3
      - qemu_x86
      - nrf52840dk_nrf52840
      - rd_rw612_bga
    integration_platforms:
      - qemu_cortex_m3
    tags: bluetooth
```

## samples/bluetooth/eddystone/sample.yaml
```yaml
sample:
  name: Bluetooth Eddystone
tests:
  sample.bluetooth.eddystone:
    harness: bluetooth
    platform_allow:
      - qemu_cortex_m3
      - qemu_x86
      - rd_rw612_bga
    tags: bluetooth
    integration_platforms:
      - qemu_cortex_m3
```

## samples/bluetooth/mtu_update/peripheral/sample.yaml
```yaml
sample:
  name: Bluetooth Peripheral MTU Update
tests:
  sample.bluetooth.peripheral_mtu_update:
    harness: bluetooth
    platform_allow:
      - qemu_cortex_m3
      - qemu_x86
      - nrf52_bsim
      - rd_rw612_bga
    tags: bluetooth
    integration_platforms:
      - qemu_cortex_m3
```

## samples/bluetooth/peripheral_accept_list/sample.yaml
```yaml
sample:
  name: Bluetooh Peripheral Accept List
tests:
  sample.bluetooth.peripheral_accept_list:
    harness: bluetooth
    platform_allow:
      - qemu_x86
      - rd_rw612_bga
    tags: bluetooth
```
