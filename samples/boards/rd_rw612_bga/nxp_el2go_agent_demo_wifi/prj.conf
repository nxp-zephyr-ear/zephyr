## CMakeLists.txt
```
# Copyright 2024 NXP
# SPDX-License-Identifier: Apache-2.0

cmake_minimum_required(VERSION 3.20.0)

find_package(Zephyr REQUIRED HINTS $ENV{ZEPHYR_BASE})

project(nxp_el2go_agent_demo_wifi)

target_sources(app
  PRIVATE
    ${APPLICATION_SOURCE_DIR}/src/psa_get_key_enrollment_algorithm.c
)

target_include_directories(app
  PRIVATE
    $<TARGET_PROPERTY:tfm,TFM_BINARY_DIR>/api_ns/interface/include
)

zephyr_include_directories(${APPLICATION_SOURCE_DIR}/src)
```

## Kconfig
```
# Copyright 2024 NXP
# SPDX-License-Identifier: Apache-2.0

source "Kconfig.zephyr"

config EL2GO_AGENT_DEMO_WIFI
	bool "Build EL2GO Agent Demo with Wi-Fi"
	depends on BUILD_WITH_TFM && MCUX_NXP_IOT_AGENT
```

## sample.yaml
```
sample:
  name: "EL2GO Agent Demo (Wi-Fi)"

tests:
  sample.boards.rd_rw612_bga.nxp_el2go_agent_demo_wifi:
    tags:
      - trusted-firmware-m
      - el2go
    platform_allow:
      - rd_rw612_bga_ns
    harness: console
    harness_config:
      type: one_line
      regex:
        - "Connecting to SSID '(.*)' \\.\\.\\."
```

## prj.conf
```kconfig
# General
CONFIG_REQUIRES_FULL_LIBC=y
CONFIG_HEAP_MEM_POOL_SIZE=65536

# TF-M S
CONFIG_BUILD_WITH_TFM=y
CONFIG_TFM_PROFILE_TYPE_NOT_SET=y
CONFIG_TFM_MBEDCRYPTO_PLATFORM_EXTRA_CONFIG_PATH="${APPLICATION_SOURCE_DIR}/src/mbedcrypto_user_config.h"

# Additional regions (TF-M S)
CONFIG_USE_TFM_WIFI_FLASH_REGION=y
CONFIG_USE_TFM_EL2GO_DATA_IMPORT_REGION=y

# TF-M IPC
CONFIG_TFM_IPC=y
CONFIG_TFM_ISOLATION_LEVEL=2

# TF-M NS
CONFIG_MCUX_NXP_IOT_AGENT=y
CONFIG_EL2GO_AGENT_DEMO_WIFI=y
CONFIG_HWINFO=y

# Networking (TF-M NS)
CONFIG_NETWORKING=y
CONFIG_NET_SOCKETS=y
CONFIG_NET_IPV4=y
CONFIG_NET_TCP=y
CONFIG_WIFI=y
CONFIG_WIFI_NXP=y
CONFIG_RW610=y

# mbedTLS (TF-M NS)
CONFIG_MBEDTLS=y
CONFIG_MBEDTLS_BUILTIN=y
CONFIG_MBEDTLS_ENABLE_HEAP=y
CONFIG_MBEDTLS_HEAP_SIZE=65536
CONFIG_MBEDTLS_ZEPHYR_ENTROPY=y
CONFIG_MBEDTLS_PSA_CRYPTO_C=y

# App specific mbedTLS (TF-M NS)
CONFIG_MBEDTLS_ECP_C=y
CONFIG_MBEDTLS_ECP_DP_SECP256R1_ENABLED=y
CONFIG_MBEDTLS_ECP_DP_SECP384R1_ENABLED=y
CONFIG_MBEDTLS_ECDH_C=y
CONFIG_MBEDTLS_ECDSA_C=y
CONFIG_MBEDTLS_KEY_EXCHANGE_ECDH_ECDSA_ENABLED=y
CONFIG_MBEDTLS_KEY_EXCHANGE_ECDHE_ECDSA_ENABLED=y
CONFIG_MBEDTLS_KEY_EXCHANGE_ECDH_RSA_ENABLED=y
CONFIG_MBEDTLS_KEY_EXCHANGE_ECDHE_RSA_ENABLED=y
CONFIG_MBEDTLS_CIPHER_MODE_CBC_ENABLED=y
CONFIG_MBEDTLS_CIPHER_GCM_ENABLED=y
CONFIG_MBEDTLS_MAC_CMAC_ENABLED=y
CONFIG_MBEDTLS_TLS_VERSION_1_2=y
CONFIG_MBEDTLS_SERVER_NAME_INDICATION=y
CONFIG_MBEDTLS_SSL_MAX_CONTENT_LEN=16384
CONFIG_MBEDTLS_PEM_CERTIFICATE_FORMAT=y
CONFIG_MBEDTLS_USER_CONFIG_ENABLE=y
CONFIG_MBEDTLS_USER_CONFIG_FILE="mbedtls_user_config.h"

# MQTT (TF-M NS)
CONFIG_MQTT_LIB=y
CONFIG_MQTT_LIB_CUSTOM_TRANSPORT=y
CONFIG_JSON_LIBRARY=y

# Debug
# CONFIG_NET_LOG=y
# CONFIG_LOG_MODE_IMMEDIATE=y
# CONFIG_MQTT_LOG_LEVEL_DBG=y
# CONFIG_MBEDTLS_DEBUG=y
# CONFIG_DEBUG_THREAD_INFO=y
# CONFIG_TFM_SPM_LOG_LEVEL_DEBUG=y
# CONFIG_TFM_EXCEPTION_INFO_DUMP=y
```

## src/mbedtls_user_config.h
```c
/*
 * Copyright 2024 NXP
 *
 * SPDX-License-Identifier: Apache-2.0
 */

#ifndef __MBEDTLS_USER_CONFIG_H__
#define __MBEDTLS_USER_CONFIG_H__

// Defines which cannot be specified in prj.conf
#define MBEDTLS_ASN1_WRITE_C
#define MBEDTLS_X509_CREATE_C
#define MBEDTLS_X509_CRT_WRITE_C
#define MBEDTLS_X509_CRL_PARSE_C
#define MBEDTLS_SSL_KEEP_PEER_CERTIFICATE
#define MBEDTLS_PSA_CRYPTO_STORAGE_C

#endif /* __MBEDTLS_USER_CONFIG_H__ */
```

## src/psa_get_key_enrollment_algorithm.c
```c
/*
 * Copyright 2024 NXP
 *
 * SPDX-License-Identifier: Apache-2.0
 */

// This is a workaround for a known issue when using TF-M PSA as backend for mbedTLS.
// There is a partial workaround in Zephyr TF-M, but it fails for our example, since we 
// actually need to link it when using the PK module of mbedTLS.
// See: https://github.com/zephyrproject-rtos/trusted-firmware-m/commit/e99f0c8d2e8f3d7733137422eeb5636b24541107
// Upstream issue: https://github.com/Mbed-TLS/mbedtls/issues/8602
//
// Will be fixed upstream in the next mbedTLS release: https://github.com/Mbed-TLS/mbedtls/pull/8607

#include <psa/crypto.h>

psa_algorithm_t psa_get_key_enrollment_algorithm(
const psa_key_attributes_t *attributes)
{
    return psa_get_key_algorithm(attributes);
}
```
