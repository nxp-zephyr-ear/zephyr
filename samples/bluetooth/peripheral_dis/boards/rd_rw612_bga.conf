## samples/bluetooth/peripheral_gatt_write/sample.yaml
```yaml
sample:
  name: Bluetooth Peripheral GATT Write
tests:
  sample.bluetooth.peripheral_gatt_write:
    harness: bluetooth
    platform_allow:
      - qemu_cortex_m3
      - qemu_x86
      - nrf52_bsim
      - rd_rw612_bga
    tags: bluetooth
    integration_platforms:
      - qemu_cortex_m3
```

## samples/bluetooth/scan_adv/sample.yaml
```yaml
sample:
  name: Bluetooth Scan & Advertise
  description: Demonstrates combined BLE Broadcaster & Observer role functionality
tests:
  sample.bluetooth.scan_adv:
    harness: bluetooth
    platform_allow:
      - qemu_cortex_m3
      - qemu_x86
      - rd_rw612_bga
    tags: bluetooth
    integration_platforms:
      - qemu_cortex_m3
```

## samples/boards/rd_rw612_bga/nxp_el2go_blob_test/Kconfig
```kconfig
# Copyright 2024 NXP
# SPDX-License-Identifier: Apache-2.0

source "Kconfig.zephyr"

config EL2GO_BLOB_TEST
	bool "Build EL2GO blob test framework"
	depends on BUILD_WITH_TFM && MCUX_NXP_IOT_AGENT
```

## samples/boards/rd_rw612_bga/nxp_el2go_blob_test/sample.yaml
```yaml
sample:
  name: "NXP EL2GO Blob Test"

tests:
  sample.boards.rd_rw612_bga.nxp_el2go_blob_test:
    tags:
      - trusted-firmware-m
      - el2go
    platform_allow:
      - rd_rw612_bga_ns
    harness: console
    harness_config:
      type: multi_line
      regex:
        - "\\#\\#\\#\\# Start EL2GO blob tests \\#\\#\\#\\#"
        - "\\#\\#\\#\\# EL2GO blob tests finished \\#\\#\\#\\#"
```

## samples/boards/rd_rw612_bga/nxp_el2go_claimcode_encryption/Kconfig
```kconfig
# Copyright 2023 NXP
# SPDX-License-Identifier: Apache-2.0

source "Kconfig.zephyr"

config EL2GO_CLAIMCODE_APP
	bool "Build EL2GO claimcode encryption application"
	depends on MCUX_ELS_PKC && MCUX_NXP_IOT_AGENT
```

## samples/boards/rd_rw612_bga/nxp_el2go_claimcode_encryption/sample.yaml
```yaml
sample:
  name: nxp el2go claimcode encryption
common:
  tags:
    - crypto
    - els_pkc
tests:
  sample.boards.rd_rw612_bga.nxp_el2go_claimcode_encryption:
    platform_allow:
      - rd_rw612_bga
    integration_platforms:
      - rd_rw612_bga
    harness: console
    harness_config:
      type: multi_line
      regex:
        - "Enabling ELS... done"
        - "claimcode information written to flash at address 0x084a0000"
```

## samples/boards/rd_rw612_bga/nxp_el2go_import_blob/sample.yaml
```yaml
sample:
  name: "EL2GO Import Blob"

tests:
  sample.boards.rd_rw612_bga.el2go_import_blob:
    tags:
      - trusted-firmware-m
      - el2go
    platform_allow:
      - rd_rw612_bga_ns
    integration_platforms:
      - rd_rw612_bga_ns
```

## samples/boards/rd_rw612_bga/nxp_mfg_bridge/Kconfig
```kconfig
# Copyright 2022-2024 NXP
# SPDX-License-Identifier: Apache-2.0

config SUPPORT_BLE_15D4
	bool "Support IEEE 802154"
	default y
	imply MONOLITHIC_IEEE802154

config SUPPORT_BLE
	bool "Support bluetooth low energy"
	imply MONOLITHIC_BT

config SUPPORT_WIFI
	bool "Support WiFi"
	default y
	imply MONOLITHIC_WIFI

source "Kconfig.zephyr"
```

## samples/net/wifi/boards/mimxrt1060_evkb.conf
```kconfig
CONFIG_WIFI_NXP=y
CONFIG_SD8987=y
CONFIG_SDIO_STACK=y
CONFIG_SDHC=y
CONFIG_IMX_USDHC=y
CONFIG_NET_L2_ETHERNET=y
CONFIG_NET_IF_MAX_IPV4_COUNT=2
CONFIG_NET_IPV6=y
CONFIG_NET_IF_MAX_IPV6_COUNT=2
CONFIG_NET_IPV6_DAD=n
CONFIG_DNS_RESOLVER=y
CONFIG_DNS_RESOLVER_MAX_SERVERS=2

CONFIG_NET_MGMT_EVENT_QUEUE_SIZE=10

CONFIG_NET_STATISTICS_WIFI=y
CONFIG_NET_STATISTICS_USER_API=y

#
# C Library
#
CONFIG_NEWLIB_LIBC=y

#
# Work Queue Options
#
CONFIG_SYSTEM_WORKQUEUE_STACK_SIZE=2048

# log & debug
CONFIG_WIFI_LOG_LEVEL_DBG=y
CONFIG_THREAD_LOCAL_STORAGE=y
CONFIG_ASSERT=y
CONFIG_ASSERT_LEVEL=2
CONFIG_LOG_MODE_IMMEDIATE=y
CONFIG_SYS_HEAP_VALIDATE=y

# os
CONFIG_EVENTS=y
CONFIG_SYS_HEAP_AUTO=y
CONFIG_SYS_HEAP_ALLOC_LOOPS=12
CONFIG_HEAP_MEM_POOL_SIZE=122880
CONFIG_POSIX_CLOCK=y

# net
CONFIG_ETH_MCUX=n
CONFIG_NET_SOCKETS=y
CONFIG_NET_ZPERF=y
CONFIG_NET_ZPERF_MAX_PACKET_SIZE=1500
CONFIG_NET_DEBUG_NET_PKT_ALLOC=y
CONFIG_NET_STATISTICS_PERIODIC_OUTPUT=y
CONFIG_NET_BUF_LOG=y
CONFIG_NET_BUF_POOL_USAGE=y
CONFIG_NET_PKT_RX_COUNT=32
CONFIG_NET_PKT_TX_COUNT=32
CONFIG_NET_BUF_RX_COUNT=32
CONFIG_NET_BUF_TX_COUNT=32
CONFIG_NET_BUF_DATA_SIZE=1500
CONFIG_NET_TC_TX_COUNT=1
CONFIG_NET_TC_RX_COUNT=1

# optimization level
# refer to Kconfig.zephyr for Optimizations Level
#CONFIG_SPEED_OPTIMIZATIONS=y
#CONFIG_SIZE_OPTIMIZATIONS=y
#CONFIG_DEBUG_OPTIMIZATIONS=y
#CONFIG_NO_OPTIMIZATIONS=y

# stack size for -O0
CONFIG_SHELL_STACK_SIZE=5120
#CONFIG_NET_TCP_WORKQ_STACK_SIZE=4096
#CONFIG_NET_TX_STACK_SIZE=4096
#CONFIG_NET_RX_STACK_SIZE=4096
CONFIG_NET_MGMT_EVENT_STACK_SIZE=2048

# wpa_supplicant
CONFIG_WPA_SUPP=y
CONFIG_WPA_SUPP_AP=y
CONFIG_WPA_SUPP_CRYPTO=y
CONFIG_WPA_SUPP_WPS=y
CONFIG_WPA_SUPP_WPA3=y

# Enable mbedtls
CONFIG_MBEDTLS=y
CONFIG_MBEDTLS_BUILTIN=y
CONFIG_CUSTOM_MBEDTLS_CFG_FILE=y
CONFIG_MBEDTLS_CFG_FILE="wpa_supp_mbedtls_config.h"
```

## samples/net/wifi/boards/mimxrt1060_evkc.conf
```kconfig
# os
CONFIG_EVENTS=y
CONFIG_SYS_HEAP_AUTO=y
CONFIG_HEAP_MEM_POOL_SIZE=122880
# Wifi chip (AM510-USD)
CONFIG_WIFI_NXP=y
CONFIG_SD8978=y
```

## samples/subsys/fs/fat_fs/boards/rd_rw612_bga.conf
```kconfig
#
# Copyright 2023 NXP
#
# SPDX-License-Identifier: Apache-2.0
#

CONFIG_DISK_DRIVERS=y
CONFIG_DISK_DRIVER_FLASH=y
# There may not be any files on the MX25 flash partition, so enable this
# Kconfig to instruct the sample to create some
CONFIG_SAMPLE_FATFS_CREATE_SOME_ENTRIES=y
```

## soc/arm/nxp_imx/rw6xx/Kconfig.defconfig.rw610
```kconfig
# NXP RW610 platform configuration options

# Copyright 2022 NXP
# SPDX-License-Identifier: Apache-2.0

if SOC_RW610

config SOC
	default "rw610"

if CORTEX_M_SYSTICK

config SYS_CLOCK_HW_CYCLES_PER_SEC
	default 260000000

endif # CORTEX_M_SYSTICK

if MCUX_OS_TIMER

config SYS_CLOCK_HW_CYCLES_PER_SEC
	default 1000000

endif # MCUX_OS_TIMER

endif # SOC_RW610
```

## soc/arm/nxp_imx/rw6xx/Kconfig.defconfig.rw612
```kconfig
# NXP RW612 platform configuration options

# Copyright 2023 NXP
# SPDX-License-Identifier: Apache-2.0

if SOC_RW612

config SOC
	default "rw612"

endif # SOC_RW612
```

## soc/arm/nxp_imx/rw6xx/Kconfig.defconfig.series
```kconfig
# RW6XX series configuration options

# Copyright 2022 NXP
# SPDX-License-Identifier: Apache-2.0

if SOC_SERIES_RW6XX

config CODE_DATA_RELOCATION_SRAM
	default y

config SOC_SERIES
	default "rw6xx"

config ROM_START_OFFSET
	default 0x1300 if NXP_RW6XX_BOOT_HEADER

config NUM_IRQS
	default 129

if BT

config FLASH
	default y

choice BT_HCI_BUS_TYPE
	default BT_NXP
endchoice

config BT_DIS_MANUF
	default "NXP"

config BT_BUF_EVT_DISCARDABLE_SIZE
	default 84

config BT_HCI_ACL_FLOW_CONTROL
	default n

config NXP_FW_LOADER
	default y

config NXP_RF_IMU
	default y

endif # BT

choice USB_MCUX_CONTROLLER_TYPE
	default USB_DC_NXP_EHCI
endchoice

if CORTEX_M_SYSTICK

config SYS_CLOCK_HW_CYCLES_PER_SEC
	default 260000000

endif # CORTEX_M_SYSTICK

if MCUX_OS_TIMER

config SYS_CLOCK_HW_CYCLES_PER_SEC
	default 1000000

endif # MCUX_OS_TIMER

# The base address is determined from the zephyr,flash node with the following
# precedence:
# FlexSPI base address (if flash node is on a FlexSPI bus)
# node reg property (used for memory regions such as SRAM)

# Workaround for not being able to have commas in macro arguments

DT_CHOSEN_Z_FLASH := zephyr,flash
DT_COMPAT_FLEXSPI := nxp,imx-flexspi

# Macros to shorten Kconfig definitions
DT_CHOSEN_FLASH_NODE := $(dt_chosen_path,$(DT_CHOSEN_Z_FLASH))
DT_CHOSEN_FLASH_PARENT := $(dt_node_parent,$(DT_CHOSEN_FLASH_NODE))

config FLASH_BASE_ADDRESS
	default $(dt_node_reg_addr_hex,$(DT_CHOSEN_FLASH_PARENT),1) \
		if $(dt_node_has_compat,$(DT_CHOSEN_FLASH_PARENT),$(DT_COMPAT_FLEXSPI))
	default $(dt_chosen_reg_addr_hex,$(DT_CHOSEN_Z_FLASH))

# The RW6xx has no internal flash. If the flash node has a size property,
# use that over the reg property. This is used for the external flash
# present on the board. Otherwise, fallback to the reg property
config FLASH_SIZE
	default $(dt_node_int_prop_int,$(DT_CHOSEN_FLASH_NODE),size,Kb) \
		if $(dt_node_has_prop,$(DT_CHOSEN_FLASH_NODE),size)
	default $(dt_chosen_reg_size_int,$(DT_CHOSEN_Z_FLASH),0,K)

if FLASH_MCUX_FLEXSPI_XIP

# Avoid RWW hazards by defaulting logging to disabled
choice FLASH_LOG_LEVEL_CHOICE
	default FLASH_LOG_LEVEL_OFF
endchoice

choice MEMC_LOG_LEVEL_CHOICE
	default MEMC_LOG_LEVEL_OFF
endchoice

endif

source "soc/arm/nxp_imx/rw6xx/Kconfig.defconfig.rw6*"

endif # SOC_SERIES_RW6XX
```

## soc/arm/nxp_imx/rw6xx/Kconfig.series
```kconfig
# RW6XX Series

# Copyright 2022 NXP
# SPDX-License-Identifier: Apache-2.0

config SOC_SERIES_RW6XX
	bool "RW6XX Series Family MCU"
	select ARM
	select CPU_CORTEX_M33
	select CPU_CORTEX_M_HAS_DWT
	select SOC_FAMILY_IMX
	select CLOCK_CONTROL
	select PLATFORM_SPECIFIC_INIT
	select CPU_HAS_ARM_SAU
	select CPU_HAS_ARM_MPU
	select CPU_HAS_FPU
	select HAS_MCUX_OS_TIMER
	select ARM_TRUSTZONE_M
	select CPU_CORTEX_M_HAS_SYSTICK
	select HAS_MCUX
	select HAS_MCUX_FLEXCOMM
	select INIT_SYS_PLL
	select HAS_MCUX_CACHE
	help
	  Enable support for RW6XX Series MCU series
```

## soc/arm/nxp_imx/rw6xx/Kconfig.soc
```kconfig
# RW6XX Series

# Copyright (c) 2022, NXP
# SPDX-License-Identifier: Apache-2.0

choice
	prompt "RW6XX Series MCU Selection"
	depends on SOC_SERIES_RW6XX

config SOC_RW610
	bool "SOC_RW610"

config SOC_RW612
	bool "SOC_RW612"

endchoice

if SOC_SERIES_RW6XX

config SOC_PART_NUMBER_RW612ETA1I
	bool

config SOC_PART_NUMBER_RW612HNA1I
	bool

config SOC_PART_NUMBER_RW612UKA1I
	bool

config SOC_PART_NUMBER_RW610ETA1I
	bool

config SOC_PART_NUMBER_RW610HNA1I
	bool

config SOC_PART_NUMBER_RW610UKA1I
	bool

config SOC_PART_NUMBER_RW6XX
	string
	default "RW612ETA1I" if SOC_PART_NUMBER_RW612ETA1I
	default "RW612HNA1I" if SOC_PART_NUMBER_RW612HNA1I
	default "RW612UKA1I" if SOC_PART_NUMBER_RW612UKA1I
	default "RW610ETA1I" if SOC_PART_NUMBER_RW610ETA1I
	default "RW610HNA1I" if SOC_PART_NUMBER_RW610HNA1I
	default "RW610UKA1I" if SOC_PART_NUMBER_RW610UKA1I
	help
	  This string holds the full part number of the SoC. It is a hidden
	  option that you should not set directly. The part number selection
	  choice defines the default value for this string.

config INIT_SYS_PLL
	bool "Initialize SYS PLL"

menuconfig NXP_RW6XX_BOOT_HEADER
	bool "Create boot header"
	help
	  Create data structures required by the boot ROM to boot the
	  application from an external flash device.

if NXP_RW6XX_BOOT_HEADER

choice BOOT_DEVICE
	prompt "Boot device selection"
	default BOOT_FLEXSPI_NOR

config BOOT_FLEXSPI_NOR
	bool "FlexSPI serial NOR"

endchoice

config FLASH_CONFIG_OFFSET
	hex "Flash config data offset"
	default 0x400
	help
	  The flash config offset provides the boot ROM with the on-board
	  flash type and parameters. The boot ROM requires a fixed flash conifg
	  offset for FlexSPI device.

config IMAGE_VECTOR_TABLE_OFFSET
	hex "Image vector table offset"
	default 0x1000
	help
	  The Image Vector Table (IVT) provides the boot ROM with pointers to
	  the application entry point and device configuration data. The boot
	  ROM requires a fixed IVT offset for each type of boot device.

endif # NXP_RW6XX_BOOT_HEADER


endif # SOC_SERIES_RW6XX
```
