/*
 * Copyright 2022 NXP
 *
 * SPDX-License-Identifier: Apache-2.0
 */

/ {
	soc {
		sram: sram@20000000 {
			ranges = <0x20000000 0x20000000 0x130000
				  0x00000000 0x00000000 0x130000>;
		};

		peripheral: peripheral@40000000 {
			ranges = <0x0 0x40000000 0x10000000>;
		};
	};
};

#include "nxp_rw6xx_common.dtsi"
